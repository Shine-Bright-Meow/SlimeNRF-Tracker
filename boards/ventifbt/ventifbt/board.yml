## boards/ventifbt/ventifbt/board.yml
```yaml
# Copyright (c) 2024 Nordic Semiconductor ASA
# SPDX-License-Identifier: Apache-2.0

board:
  name: ventifbt
  full_name: VentiFBT R3
  vendor: ventifbt
  socs:
    - name: nrf52840
      variants:
      - name: 'uf2'
```

## boards/ventifbt/ventifbt/ventifbt_nrf52840_uf2_defconfig
```kconfig
# Copyright (c) 2024 Nordic Semiconductor ASA
# SPDX-License-Identifier: Apache-2.0

CONFIG_ARM_MPU=y
CONFIG_HW_STACK_PROTECTION=y

CONFIG_SLIMEVR_USB_DEVICE_MANUFACTURER="VentiFBT"
CONFIG_SLIMEVR_USB_DEVICE_PRODUCT="SlimeNRF Tracker VentiFBT"

CONFIG_BATTERY_USE_REG_LDO_MAPPING=y
CONFIG_LED_RGB_COLOR=y

#generate for adafruit uf2 bootloader flashing
CONFIG_BUILD_OUTPUT_UF2=y
```

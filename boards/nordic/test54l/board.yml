## boards/nordic/test54l/board.yml
```yaml
board:
  name: test54l
  vendor: nordic
  socs:
  - name: nrf54l15
    variants:
    - name: xip
      cpucluster: cpuflpr
```

## boards/ventifbt/ventifbt/ventifbt_defconfig
```kconfig
# Copyright (c) 2024 Nordic Semiconductor ASA
# SPDX-License-Identifier: Apache-2.0

CONFIG_ARM_MPU=y
CONFIG_HW_STACK_PROTECTION=y

CONFIG_USB_DEVICE_STACK=y
CONFIG_USB_DEVICE_MANUFACTURER="VentiFBT"
CONFIG_USB_DEVICE_PRODUCT="SlimeNRF Tracker VentiFBT"

CONFIG_BATTERY_USE_REG_LDO_MAPPING=y
CONFIG_LED_RGB_COLOR=n

CONFIG_LED_DEFAULT_COLOR_R=10000
CONFIG_LED_DEFAULT_COLOR_G=7176
CONFIG_LED_DEFAULT_COLOR_B=7725
```
